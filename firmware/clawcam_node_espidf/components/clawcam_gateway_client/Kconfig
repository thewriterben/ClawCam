## firmware/clawcam_node_espidf/components/clawcam_gateway_client/Kconfig
```kconfig
menu "ClawCam Gateway Client"

config CLAWCAM_GATEWAY_UPLOAD_ENABLED
    bool "Enable HTTP upload to ClawCam gateway"
    default n
    help
        Enable the firmware-to-gateway HTTP upload path. SD/FATFS artifacts
        remain the offline source of truth; failed uploads should not delete or
        alter local artifacts.

config CLAWCAM_GATEWAY_BASE_URL
    string "ClawCam gateway base URL"
    default "http://192.168.4.1:8080"
    depends on CLAWCAM_GATEWAY_UPLOAD_ENABLED
    help
        Base URL for the local field gateway, without a trailing slash.

config CLAWCAM_GATEWAY_HTTP_TIMEOUT_MS
    int "Gateway HTTP timeout in milliseconds"
    default 5000
    range 1000 60000
    depends on CLAWCAM_GATEWAY_UPLOAD_ENABLED

endmenu
```

## firmware/clawcam_node_espidf/components/clawcam_storage/Kconfig
```kconfig
menu "ClawCam Storage"

config CLAWCAM_STORAGE_USE_FATFS_SDMMC
    bool "Enable SDMMC/FATFS storage path"
    default n
    help
        Enable the ESP-IDF SDMMC/FATFS-backed storage path. When disabled,
        the ClawCam storage component remains scaffold-safe and media/metadata
        writes return ESP_ERR_NOT_SUPPORTED.

config CLAWCAM_STORAGE_PERSIST_SMOKE_TEST_CAPTURE
    bool "Persist camera smoke-test capture to storage"
    default n
    depends on CLAWCAM_STORAGE_USE_FATFS_SDMMC
    help
        Save the boot-time camera smoke-test JPEG and metadata to storage when
        a capture succeeds. This is intended for bench validation and requires
        a mounted SD card.

config CLAWCAM_STORAGE_MAX_FILES
    int "Maximum open files for FATFS mount"
    default 5
    range 1 16
    depends on CLAWCAM_STORAGE_USE_FATFS_SDMMC

config CLAWCAM_STORAGE_FORMAT_IF_MOUNT_FAILED
    bool "Format SD card if mount fails"
    default n
    depends on CLAWCAM_STORAGE_USE_FATFS_SDMMC
    help
        Leave disabled for field safety. Enable only during controlled bench
        testing when card contents may be erased.

endmenu
```

## firmware/clawcam_node_espidf/sdkconfig.defaults.esp32s3_eye
```kconfig
# ClawCam ESP32-S3-EYE v2.2 build defaults
#
# Use with:
#   idf.py -D SDKCONFIG_DEFAULTS=sdkconfig.defaults.esp32s3_eye set-target esp32s3 build
#
# This profile enables the first hardware camera smoke-test path. It still
# requires physical ESP32-S3-EYE hardware validation before the board can be
# described as supported.

CONFIG_IDF_TARGET="esp32s3"
CONFIG_ESPTOOLPY_FLASHSIZE_8MB=y
CONFIG_ESPTOOLPY_FLASHSIZE="8MB"
CONFIG_SPIRAM=y
CONFIG_SPIRAM_MODE_OCT=y
CONFIG_SPIRAM_SPEED_80M=y
CONFIG_SPIRAM_USE_MALLOC=y
CONFIG_FREERTOS_HZ=1000
CONFIG_LOG_DEFAULT_LEVEL_INFO=y
CONFIG_CLAWCAM_CAMERA_USE_ESP_CAMERA=y
CONFIG_CLAWCAM_CAMERA_SMOKE_TEST_ON_BOOT=y
CONFIG_CLAWCAM_CAMERA_SMOKE_TEST_RETRY_COUNT=1
CONFIG_CLAWCAM_STORAGE_USE_FATFS_SDMMC=y
CONFIG_CLAWCAM_STORAGE_PERSIST_SMOKE_TEST_CAPTURE=y
CONFIG_CLAWCAM_STORAGE_MAX_FILES=5
# Keep formatting disabled by default to avoid destructive bench/field behavior.
# CONFIG_CLAWCAM_STORAGE_FORMAT_IF_MOUNT_FAILED is not set
```
