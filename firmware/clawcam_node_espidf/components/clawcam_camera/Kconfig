## firmware/clawcam_node_espidf/components/clawcam_camera/Kconfig
```kconfig
menu "ClawCam Camera"

config CLAWCAM_CAMERA_USE_ESP_CAMERA
    bool "Enable esp32-camera hardware capture path"
    default n
    help
        Enable this only when the espressif/esp32-camera component is available
        in the ESP-IDF project. When disabled, the ClawCam camera component
        initializes in scaffold mode and capture returns ESP_ERR_NOT_SUPPORTED.

config CLAWCAM_CAMERA_SMOKE_TEST_ON_BOOT
    bool "Run one camera capture smoke test at boot"
    default n
    depends on CLAWCAM_CAMERA_USE_ESP_CAMERA
    help
        Run a single JPEG capture after camera initialization, log the frame
        size, and release the framebuffer. This is intended for bench testing
        the first ESP32-S3-EYE hardware camera path.

config CLAWCAM_CAMERA_SMOKE_TEST_RETRY_COUNT
    int "Camera smoke test retry count"
    default 1
    range 1 5
    depends on CLAWCAM_CAMERA_SMOKE_TEST_ON_BOOT
    help
        Number of capture attempts during the boot-time smoke test.

config CLAWCAM_IRCUT_GPIO_A
    int "IR-cut filter H-bridge input A GPIO (-1 = no filter)"
    default -1
    range -1 48
    help
        For a camera module with a two-wire IR-cut filter (for example the
        OV5640 110 degree module with IR-cut switch). The two filter wires go
        to an H-bridge output (DRV8833, TB6612, L9110S), never to GPIOs; this
        is the bridge's first input. Leave both at -1 when there is no filter.
        The ESP32-S3-EYE has almost no free GPIO: check the schematic before
        choosing. Boards with the same camera map and a free header can use
        41 and 42.

config CLAWCAM_IRCUT_GPIO_B
    int "IR-cut filter H-bridge input B GPIO (-1 = no filter)"
    default -1
    range -1 48

config CLAWCAM_IRCUT_ENGAGE_ON_A
    bool "Pulsing input A puts the filter in (day)"
    default y
    help
        Depends on which way round the two coil wires are. If night pictures
        look like day pictures and the other way about, flip this or swap the
        wires.

config CLAWCAM_IRCUT_PULSE_MS
    int "IR-cut filter pulse length (ms)"
    default 150
    range 20 1000

config CLAWCAM_DAY_NIGHT_AUTO
    bool "Switch the IR-cut filter automatically from scene light"
    default y
    depends on CLAWCAM_CAMERA_USE_ESP_CAMERA
    help
        One reading per wake, taken from the OV5640's average, gain and
        exposure registers before the capture. Does nothing unless both IR-cut
        GPIOs are set and the sensor is an OV5640.

config CLAWCAM_DAY_NIGHT_NIGHT_BELOW
    int "Go to night when scene light stays below this"
    default 8
    range 1 100000
    depends on CLAWCAM_DAY_NIGHT_AUTO
    help
        An estimate, not a measurement. The reading is logged every wake as
        "light=" so it can be replaced with one.

config CLAWCAM_DAY_NIGHT_DAY_ABOVE
    int "Go back to day when scene light stays above this"
    default 60
    range 2 100000
    depends on CLAWCAM_DAY_NIGHT_AUTO
    help
        Must be well above the night threshold: with the filter out the same
        scene reads brighter, and too small a gap makes the filter flap.

config CLAWCAM_DAY_NIGHT_DWELL
    int "Consecutive wakes needed before switching"
    default 2
    range 1 20
    depends on CLAWCAM_DAY_NIGHT_AUTO

endmenu
```

## firmware/clawcam_node_espidf/components/clawcam_mqtt/Kconfig
```kconfig
menu "ClawCam MQTT"

config CLAWCAM_MQTT_BROKER_URL
    string "MQTT broker URL"
    default "mqtt://192.168.4.1"
    help
        Broker the node publishes events/health to. May include a port
        (e.g. mqtt://192.168.4.1:1883); otherwise CLAWCAM_MQTT_PORT is
        appended. Matches the gateway's MQTT bridge.

config CLAWCAM_MQTT_PORT
    int "MQTT broker port"
    default 1883
    range 1 65535

config CLAWCAM_MQTT_KEEPALIVE
    int "MQTT keepalive (seconds)"
    default 15
    range 5 300

config CLAWCAM_MQTT_QOS_EVENTS
    int "QoS for event publishes"
    default 1
    range 0 2

endmenu
```

## firmware/clawcam_node_espidf/main/Kconfig.projbuild
```kconfig
menu "ClawCam Node"

config CLAWCAM_PIR_GPIO
    int "PIR motion sensor GPIO (-1 to disable)"
    default -1
    range -1 48
    help
        GPIO connected to the PIR sensor output, used for EXT0 deep-sleep
        wake. Set to -1 on boards without a PIR sensor. NOTE: the
        ESP32-S3-EYE has no built-in PIR, and its GPIO 13 is the camera
        PCLK pin — never route a PIR there. When disabled (-1) the node
        wakes on timer only.

config CLAWCAM_BATTERY_ADC_CHANNEL
    int "Battery voltage ADC1 channel (-1 to disable)"
    default -1
    range -1 9
    help
        ADC1 channel wired to the battery voltage divider. -1 disables
        battery monitoring (the ESP32-S3-EYE has no battery sense pin);
        health reports then omit the battery block and low-battery
        protection is inactive.

config CLAWCAM_WIFI_ENABLED
    bool "Connect to Wi-Fi at boot"
    default n
    help
        Bring up the Wi-Fi station interface at boot. Required for the
        gateway upload path (HTTP/MQTT/OTA); without it every network
        call fails and the SD card remains the only artifact store.

config CLAWCAM_WIFI_SSID
    string "Wi-Fi SSID"
    default ""
    depends on CLAWCAM_WIFI_ENABLED

config CLAWCAM_WIFI_PASSWORD
    string "Wi-Fi password (WPA2-PSK; empty for open networks)"
    default ""
    depends on CLAWCAM_WIFI_ENABLED

config CLAWCAM_WIFI_CONNECT_TIMEOUT_MS
    int "Wi-Fi connect timeout (ms)"
    default 10000
    range 1000 60000
    depends on CLAWCAM_WIFI_ENABLED
    help
        How long to wait for an IP before continuing the wake cycle
        offline. Uploads are skipped when the connection fails; SD
        artifacts remain the source of truth.

endmenu
```
